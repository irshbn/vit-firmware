## yocto/build/conf/bblayers.conf
```bitbake
BBPATH = "${TOPDIR}"
BBFILES ?= ""

BBLAYERS ?= " \
  /home/build/work/sources/poky/meta \
  /home/build/work/sources/poky/meta-poky \
  /home/build/work/sources/poky/../meta-xilinx/meta-microblaze \
  /home/build/work/sources/poky/../meta-xilinx/meta-xilinx-core \
  /home/build/work/sources/poky/../meta-xilinx/meta-xilinx-standalone \
  /home/build/work/sources/poky/../meta-xilinx/meta-xilinx-standalone-sdt \
  /home/build/work/sources/poky/../meta-xilinx/meta-xilinx-bsp \
  /home/build/work/sources/poky/../meta-xilinx/meta-xilinx-vendor \
  /home/build/work/sources/poky/../meta-xilinx/meta-xilinx-virtualization \
  /home/build/work/sources/poky/../meta-xilinx/meta-xilinx-mali400 \
  /home/build/work/sources/poky/../meta-xilinx/meta-xilinx-demos \
  /home/build/work/sources/poky/../meta-xilinx/meta-xilinx-multimedia \
  /home/build/work/sources/poky/../meta-xilinx-tools \
  /home/build/work/sources/poky/../meta-amd-adaptive-socs/meta-amd-adaptive-socs-core \
  /home/build/work/sources/poky/../meta-amd-adaptive-socs/meta-amd-adaptive-socs-bsp \
  /home/build/work/sources/poky/../meta-arm/meta-arm \
  /home/build/work/sources/poky/../meta-arm/meta-arm-toolchain \
  /home/build/work/sources/poky/../meta-openembedded/meta-perl \
  /home/build/work/sources/poky/../meta-openembedded/meta-python \
  /home/build/work/sources/poky/../meta-openembedded/meta-filesystems \
  /home/build/work/sources/poky/../meta-openembedded/meta-gnome \
  /home/build/work/sources/poky/../meta-openembedded/meta-multimedia \
  /home/build/work/sources/poky/../meta-openembedded/meta-networking \
  /home/build/work/sources/poky/../meta-openembedded/meta-webserver \
  /home/build/work/sources/poky/../meta-openembedded/meta-xfce \
  /home/build/work/sources/poky/../meta-openembedded/meta-initramfs \
  /home/build/work/sources/poky/../meta-openembedded/meta-oe \
  /home/build/work/sources/poky/../meta-xilinx/meta-xilinx-contrib \
  /home/build/work/sources/poky/../meta-virtualization \
  /home/build/work/sources/poky/../meta-kria \
  /home/build/work/sources/poky/../meta-embedded-plus \
  /home/build/work/sources/poky/../meta-security \
  /home/build/work/sources/poky/../meta-security/meta-tpm \
  /home/build/work/sources/poky/../meta-xilinx-tsn \
  /home/build/work/sources/poky/../meta-petalinux \
  /home/build/work/sources/poky/../meta-openamp \
  /home/build/work/sources/poky/../meta-qt5 \
  /home/build/work/sources/poky/../meta-aws \
  /home/build/work/sources/poky/../meta-jupyter \
  /home/build/work/sources/poky/../meta-rauc \
  /home/build/work/sources/poky/../meta-system-controller \
  /home/build/work/sources/poky/../meta-ros/meta-ros-common \
  /home/build/work/sources/poky/../meta-ros/meta-ros2 \
  /home/build/work/sources/poky/../meta-ros/meta-ros2-jazzy \
  /home/build/work/sources/meta-vit-fpga \
  "
```

## yocto/sources/meta-vit-fpga/conf/layer.conf
```bitbake
# We have a conf and classes directory, add to BBPATH
BBPATH .= ":${LAYERDIR}"

# We have recipes-* directories, add to BBFILES
BBFILES += "${LAYERDIR}/recipes-*/*/*.bb \
            ${LAYERDIR}/recipes-*/*/*.bbappend"

BBFILE_COLLECTIONS += "meta-vit-fpga"
BBFILE_PATTERN_meta-vit-fpga = "^${LAYERDIR}/"
BBFILE_PRIORITY_meta-vit-fpga = "7"

LAYERDEPENDS_meta-vit-fpga = "petalinux networking-layer"
LAYERSERIES_COMPAT_meta-vit-fpga = "scarthgap"
```

## yocto/sources/meta-vit-fpga/wic/grow-home.wks
```
# Description: Creates a partitioned SD card image.
# Boot files are located in the first partition (vfat).
# Rootfs is in the second partition (ext4).
# Home partition is the third partition (ext4)
part --source bootimg-partition --fstype=vfat --label boot --active --align 4 --fixed-size 128M
part /     --source rootfs --rootfs-dir=${IMAGE_ROOTFS}      --fstype=ext4 --label root --align 4 --fixed-size 256M
part /home --source rootfs --rootfs-dir=${IMAGE_ROOTFS}/home --fstype=ext4 --label home --align 4 --fixed-size 1M --ondisk mmcblk0
```
